## conf/layer.conf
```bitbake
# We have a conf and classes directory, add to BBPATH
BBPATH .= ":${LAYERDIR}"

# We have recipes-* directories, add to BBFILES
BBFILES += "${LAYERDIR}/recipes-*/*/*.bb \
            ${LAYERDIR}/recipes-*/*/*.bbappend"

BBFILE_COLLECTIONS += "iris-thirdparty"
BBFILE_PATTERN_iris-thirdparty = "^${LAYERDIR}/"
BBFILE_PRIORITY_iris-thirdparty = "6"

LAYERDEPENDS_iris-thirdparty = "core \
                                openembedded-layer"

LAYERSERIES_COMPAT_iris-thirdparty = "honister"

LICENSE_PATH += "${LAYERDIR}/licenses"
```
